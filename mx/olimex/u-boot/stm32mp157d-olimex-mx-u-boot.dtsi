// SPDX-License-Identifier: GPL-2.0+ OR BSD-3-Clause
/*
 * Copyright : STMicroelectronics 2018
 */

//#include <dt-bindings/clock/stm32mp1-clksrc.h>
//#include "stm32mp15-u-boot.dtsi"
#include "stm32mp15-scmi-u-boot.dtsi"
//#include "stm32mp15-ddr3-2x4Gb-1066-binG.dtsi"

/ {
	aliases {
		mmc0 = &sdmmc1;
		usb0 = &usbotg_hs;
	};
	config {
	};
};
